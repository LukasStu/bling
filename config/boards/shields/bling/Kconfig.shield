## config/boards/shields/bling/Kconfig.shield
```kconfig
# Copyright (c) 2020 The ZMK Contributors
# SPDX-License-Identifier: MIT

# No whitespace after the comma or in the keyboard nam
config SHIELD_DONGLE
    def_bool $(shields_list_contains,bling)

config SHIELD_BLING_LEFT
    def_bool $(shields_list_contains,bling_left)

config SHIELD_BLING_RIGHT
    def_bool $(shields_list_contains,bling_right)
```

## config/west.yml
```yaml
manifest:
  remotes:
    # zmk official
    - name: zmkfirmware
      url-base: https://github.com/zmkfirmware
    # Dongle Display
    - name: LukasStu
      url-base: https://github.com/LukasStu
  projects:
    - name: zmk
      remote: zmkfirmware
      revision: main
      import: app/west.yml
    - name: zmk-dongle-display
      remote: LukasStu
      revision: main
  self:
    path: config
```
